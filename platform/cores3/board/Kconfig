## platform/cores3/board/Kconfig
```kconfig
# CoreS3 resources are configured by the ESP32-S3 UART/I2C Kconfig.

config ESP32S3_M5_CORES3_GPIO10_IRQ
	bool "Register GPIO10 as a rising edge input"
	depends on DEV_GPIO && ESPRESSIF_GPIO_IRQ && BOARD_LATE_INITIALIZE
	---help---
		Register M-Bus pin 2 as /dev/gpio10.

config ESP32S3_M5_CORES3_LCD
	bool "Register the built-in CoreS3 SPI LCD endpoint"
	depends on ESP32S3_I2C0_MASTER_MODE && ESP32S3_SPI2
	depends on ESP32S3_SPI_SWCS && !ESP32S3_SPI_UDCS
	depends on SPI_DRIVER && SPI_CMDDATA && BOARD_LATE_INITIALIZE
	depends on !MMCSD_SPI && ESP32S3_SPI2_MISOPIN = -1
	---help---
		Bring up the panel rails and register SPI2 for the write-only LCD.
		GPIO35 is LCD D/C in this mode, so SD card SPI is unavailable.

config ESP32S3_M5_CORES3_TOUCH
	bool "Register the built-in CoreS3 touchscreen"
	depends on ESP32S3_M5_CORES3_LCD && INPUT_FT5X06
	depends on FT5X06_POLLMODE && FT5X06_SINGLEPOINT
	---help---
		Enable the FT6336 reset line on the AW9523 and register /dev/input0.
```

## tests/nuttx-std/heap-replay/Kconfig
```kconfig
config EXAMPLES_HEAP_REPLAY
	bool "Isolated heap replay qualification fixture"
	default n
	depends on ARCH_BOARD_MPS2_AN521 && MM_DEFAULT_MANAGER && BUILD_FLAT && !SMP
	---help---
		Qualification only. A private fixed arena and explicit link wrappers
		expose committed allocator topology to a read-only stopped observer.
		No production allocator implementation is modified.
```

## tests/nuttx-std/heap-requests/Kconfig
```kconfig
config EXAMPLES_HEAP_REQUESTS
	bool "Native allocator request/result qualification fixture"
	default n
	depends on ARCH_BOARD_MPS2_AN521 && MM_DEFAULT_MANAGER && BUILD_FLAT && !SMP
	depends on MM_ALLOC_REQUEST_TRACE && DRIVERS_NOTECTL && DRIVERS_NOTERAM
	depends on SCHED_INSTRUMENTATION_DUMP
	---help---
		Qualification only. Exercise the production allocator note patch in
		a private fixed heap. Return values and payload preservation are
		retained separately from the native note stream. This does not
		produce a heap topology journal or measure product timing costs.
```

## tests/nuttx-std/memory-timing/Kconfig
```kconfig
config EXAMPLES_MEMORY_TIMING
	bool "Memory explorer timing qualification fixture"
	default n
	depends on DRIVERS_NOTECTL && DRIVERS_NOTERAM
	depends on SCHED_INSTRUMENTATION_SWITCH && SCHED_INSTRUMENTATION_IRQHANDLER
	depends on SCHED_INSTRUMENTATION_DUMP && !DISABLE_PTHREAD && !SMP

config EXAMPLES_MEMORY_TIMING_CMSDK_CLOCK
	bool "Use the QEMU qualification CMSDK perf clock adapter"
	default n
	depends on EXAMPLES_MEMORY_TIMING && ARCH_BOARD_MPS2_AN521
	---help---
		Qualification only: reserve the otherwise unused CMSDK APB timer1
		in QEMU's AN521 model as a free-running 20 MHz counter with IRQ off.
		QEMU does not implement the ARM DWT cycle counter. The SysTick
		time-base interpolation is not monotonic at IRQ entry in this build.
		The build must also pass the three explicit --wrap linker options.
```

## tests/nuttx-std/timed-capture/Kconfig
```kconfig
config EXAMPLES_TIMED_CAPTURE
	bool "Finite trace capture qualification fixture"
	default n
	depends on SYSTEM_TRACE_CAPTURE && ARCH_BOARD_MPS2_AN521
	depends on SCHED_INSTRUMENTATION_DUMP && DRIVERS_NOTERAM
	depends on SCHED_WAITPID && !DISABLE_PTHREAD && !SMP
	depends on SIG_DEFAULT && SIG_SIGKILL_ACTION
	---help---
		Qualification only. Run the actual trace capture builtin while a
		bounded worker emits simulated 1 Hz and 2 Hz GNSS operations. Reserve
		the otherwise unused QEMU CMSDK timer1 for the explicit perf adapter.
```
